## config/west.yml
```yaml
manifest:
  remotes:
    - name: zubairabid
      url-base: https://github.com/zubairabid
  projects:
    - name: zmk
      remote: zubairabid
      revision: shield/lotus58_oledwork
      import: app/west.yml
  self:
    path: config
```
